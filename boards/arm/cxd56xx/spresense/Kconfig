## boards/arm/cxd56xx/spresense/Kconfig
```kconfig
#
# For a description of the syntax of this configuration file,
# see the file kconfig-language.txt in the NuttX tools repository.
#

if ARCH_BOARD_SPRESENSE

config BOARD_CUSTOM_PINCONFIG
	bool
	default y

config BOARD_USB_DISABLE_IN_DEEP_SLEEPING
	bool
	default y
	---help---
		Due to the system specification, it's impossible to enter the deep
		sleeping mode for the power saving as long as USB is attached. As
		the workaround for this restriction, this configuration forces to be
		disable the USB function in deep sleeping.

config CXD56_SPIFLASHSIZE
	hex
	default 0x400000
	depends on CXD56_SFC
	---help---
		Specify the SPI flash total available size for the application.
		This value is generally set half of SPI flash device capacity.

config SPRESENSE_EXTENSION
	bool "Extension board"
	default n
	select CXD56_CUSTOM_PINCONFIG
	---help---
		Indicates to the configuration that an SPresense extension board is
		present.  If there is no extension board attached, the SPresense
		may run in a low-power mode by default (as determined by the
		CONFIG_CXD56_CUSTOM_PINCONFIG option).  If an extension board is
		present, then the SPresense will need to run at a higher power mode,
		selected by this option.

if  SPRESENSE_EXTENSION
config SDCARD_TXS02612
	bool "SD Card TXS02612 port expander with voltage level translation"
	default y
	---help---
		Enable TXS02612 Dual Voltage Level Translator for SD-Card interface.
		This device is used in SPD-003C board.

if SDCARD_TXS02612

choice
	prompt "TXS02612 port"
	default SDCARD_TXS02612_PORT0

config SDCARD_TXS02612_PORT0
	bool "Port 0"

config SDCARD_TXS02612_PORT1
	bool "Port 1"

endchoice # "TXS02612 port"

endif # SDCARD_TXS02612
endif # SPRESENSE_EXTENSION

if LCD

choice
	prompt "LCD SPI connection"
	default LCD_ON_EXTENSION_BOARD

config LCD_ON_EXTENSION_BOARD
	bool "Extension board: SPI4"
	select CXD56_SPI4
	select CXD56_DMAC_SPI4_TX
	select CXD56_DMAC_SPI4_RX
	---help---
		Display connected to extension board.

config LCD_ON_MAIN_BOARD
	bool "Main board: SPI5"
	select CXD56_SPI5
	select CXD56_DMAC_SPI5_TX
	select CXD56_DMAC_SPI5_RX
	---help---
		Display connected to main board.

endchoice
endif
config CXD56_IMAGEPROC
	bool "Spresense Image Processor"
	default n
	select CXD56_GE2D
	---help---
		Enable support for accelerated format converter, rotation and so on.
		using the CXD5602 image processing accelerator.

comment "LTE Options"

menuconfig CXD56_LTE
	bool "LTE"
	default n

if CXD56_LTE

choice
	prompt "LTE SPI selection"
	default CXD56_LTE_SPI4

config CXD56_LTE_SPI4
	bool "Use SPI4"
	select CXD56_SPI4

config CXD56_LTE_SPI5
	bool "Use SPI5"
	select CXD56_SPI5
endchoice

if CXD56_LTE_SPI4

config CXD56_LTE_SPI4_DMAC
	bool "Use DMAC for SPI4"
	default y
	select CXD56_DMAC_SPI4_TX
	select CXD56_DMAC_SPI4_RX

endif # CXD56_LTE_SPI4

if CXD56_LTE_SPI5

config CXD56_LTE_SPI5_DMAC
	bool "Use DMAC for SPI5"
	default y
	select CXD56_DMAC_SPI5_TX
	select CXD56_DMAC_SPI5_RX

endif # CXD56_LTE_SPI5

endif # CXD56_LTE

menu "WIZnet Ethernet on CXD5602"

if NET_WIZNET

choice
	prompt "WIZnet SPI selection"
	default CXD56_WIZNET_SPI5

config CXD56_WIZNET_SPI4
	bool "Use SPI4"
	select CXD56_SPI4

config CXD56_WIZNET_SPI5
	bool "Use SPI5"
	select CXD56_SPI5

endchoice

if CXD56_WIZNET_SPI4

config CXD56_WIZNET_SPI4_DMAC
	bool "Use DMAC for SPI4"
	default n
	select CXD56_DMAC_SPI4_TX
	select CXD56_DMAC_SPI4_RX

endif # CXD56_WIZNET_SPI4

if CXD56_WIZNET_SPI5

config CXD56_WIZNET_SPI5_DMAC
	bool "Use DMAC for SPI5"
	default n
	select CXD56_DMAC_SPI5_TX
	select CXD56_DMAC_SPI5_RX

endif # CXD56_WIZNET_SPI5

choice CXD56_WIZNET_PIN_RST
	prompt "WIZnet Reset pin configuration."
	default CXD56_WIZNET_RST_EMMC_DATA3

config CXD56_WIZNET_RST_EMMC_DATA3
	bool "Use PIN EMMC_DATA3"

config CXD56_WIZNET_RST_I2S0_BCK
	bool "Use PIN I2S0_BCK"

endchoice

choice CXD56_WIZNET_PIN_INT
	prompt "WIZnet Interrupt pin configuration."
	default CXD56_WIZNET_INT_EMMC_DATA2

config CXD56_WIZNET_INT_EMMC_DATA2
	bool "Use PIN EMMC_DATA2"

config CXD56_WIZNET_INT_I2S0_LRCK
	bool "Use PIN I2S0_LRCK"

endchoice

config CXD56_WIZNET_USE_SWCS
	bool "Use GPIO (I2S_DIN) as a Chip Select pin."
	default y

endif # NET_WIZNET

endmenu # "WIZnet Ethernet on CXD5602"

endif
```

## configs/cxd56evb/nsh/defconfig
```kconfig
# CONFIG_NSH_ARGCAT is not set
# CONFIG_NSH_CMDOPT_DF_H is not set
# CONFIG_NSH_CMDOPT_HEXDUMP is not set
# CONFIG_NSH_CMDPARMS is not set
# CONFIG_STANDARD_SERIAL is not set
CONFIG_ARCH="arm"
CONFIG_ARCH_BOARD="cxd56evb"
CONFIG_ARCH_BOARD_CXD56EVB=y
CONFIG_ARCH_CHIP_CXD56XX=y
CONFIG_ARCH_STACKDUMP=y
CONFIG_ARMV7M_USEBASEPRI=y
CONFIG_BOARD_LOOPSPERMSEC=5434
CONFIG_BOOT_RUNFROMISRAM=y
CONFIG_BUILTIN=y
CONFIG_CLOCK_MONOTONIC=y
CONFIG_DEBUG_FULLOPT=y
CONFIG_DEBUG_SYMBOLS=y
CONFIG_DISABLE_POLL=y
CONFIG_EXAMPLES_NSH=y
CONFIG_EXAMPLES_NSH_CXXINITIALIZE=y
CONFIG_FS_PROCFS=y
CONFIG_HAVE_CXX=y
CONFIG_HAVE_CXXINITIALIZE=y
CONFIG_I2C=y
CONFIG_MAX_TASKS=16
CONFIG_MAX_WDOGPARMS=2
CONFIG_NFILE_DESCRIPTORS=8
CONFIG_NFILE_STREAMS=8
CONFIG_NSH_BUILTIN_APPS=y
CONFIG_NSH_FILEIOSIZE=512
CONFIG_NSH_LINELEN=64
CONFIG_NSH_READLINE=y
CONFIG_PREALLOC_MQ_MSGS=4
CONFIG_PREALLOC_TIMERS=4
CONFIG_PREALLOC_WDOGS=16
CONFIG_RAM_SIZE=1572864
CONFIG_RAM_START=0x0d000000
CONFIG_RR_INTERVAL=200
CONFIG_SCHED_WAITPID=y
CONFIG_SDCLONE_DISABLE=y
CONFIG_SPI=y
CONFIG_START_DAY=6
CONFIG_START_MONTH=12
CONFIG_START_YEAR=2011
CONFIG_UART1_SERIAL_CONSOLE=y
CONFIG_USER_ENTRYPOINT="nsh_main"
```

## drivers/modem/alt1250/Kconfig
```kconfig
#
# For a description of the syntax of this configuration file,
# see the file kconfig-language.txt in the NuttX tools repository.
#

menuconfig MODEM_ALT1250
	bool "ALT1250 modem support"
	default n
	select SPI
	select NET
	select NETDEV_MODEM_LTE_IOCTL
	---help---
		Enable driver for the ALT1250 modem.

if MODEM_ALT1250

config HAVE_SSLHANDLER
	bool "Use SSL handler"
	default n
	---help---
		Enable or disable compose/parse packt handler for SSL.

config HAVE_EXTHANDLER
	bool "Use extension handler"
	default n
	---help---
		Enable or disable compose/parse packt handler for extension.

config MODEM_ALT1250_DEBUG
	bool "Enable debug mode for ALT1250 modem driver"
	default n
	---help---
		Allow the ALT1250 modem driver print debug information.

endif
```

## drivers/net/wiznet/Kconfig
```kconfig
#
# For a description of the syntax of this configuration file,
# see the file kconfig-language.txt in the NuttX tools repository.
#

menuconfig NET_WIZNET
	bool "WIZnet W5x00 Ethernet Support"
	default n
	select SPI
	---help---
		Enable driver for WIZnet W5x00 ethernet

if NET_WIZNET

choice
	prompt "WIZnet W5x00 device selection"
	default NET_WIZNET_W5500

config NET_WIZNET_W5100
	bool "Use WIZnet W5100 device"

config NET_WIZNET_W5100S
	bool "Use WIZnet W5100S device"

config NET_WIZNET_W5200
	bool "Use WIZnet W5200 device"

config NET_WIZNET_W5300
	bool "Use WIZnet W5300 device"

config NET_WIZNET_W5500
	bool "Use WIZnet W5500 device"
endchoice

config NET_WIZNET_SPI_FREQUENCY
	int "SPI frequency for WIZnet"
	default 14000000
	range 4000000 20000000

config NET_WIZNET_MAX_PACKET_SIZE
  int "Max size to be transfer in bytes"
  default 2051
  ---help---
    Maximum send/recv data buffer size + 3 bytes header size

endif # NET_WIZNET
```

## net/devspecsock/Kconfig
```kconfig
#
# For a description of the syntax of this configuration file,
# see misc/tools/kconfig-language.txt.
#

menu "Deivce-specific networking stack API"

config NET_DEV_SPEC_SOCK
	bool "Deivce-specific networking stack API"
	default n
	depends on NET
	---help---
		Enable or disable deivce-specific networking stack support.
		Implement socket interface depending on device specification
		and register that using devspecsock_register.

if NET_DEV_SPEC_SOCK

config NET_DEV_SPEC_SOCK_CONNS
	int "Number of deivce-specific connections"
	default 10
	---help---
		Maximum number of deivce-specific connections (all tasks).

endif # NET_DEV_SPEC_SOCK

endmenu # Deivce-specific networking stack API
```
